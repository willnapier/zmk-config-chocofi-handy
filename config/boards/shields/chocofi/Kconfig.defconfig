## config/west.yml
```yaml
manifest:
  remotes:
    - name: zmkfirmware
      url-base: https://github.com/zmkfirmware
  projects:
    - name: zmk
      remote: zmkfirmware
      # Match Temper/Urchin: v0.3
      revision: v0.3
      import: app/west.yml
  self:
    path: config
```
